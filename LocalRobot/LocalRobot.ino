#include <XM430.h>
#include <SoftwareSerial.h>



int Val_X[] = {3030,
               3030,
               3030,
               3030,
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               2068,
               2068
              };
int Val_Y[] = {100,
               100,
               100,
               100,
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               4000,
               4000
              };

float x;
float y;
float easing = 0.05;
float easing_time = 200;

int x_Out;
int y_Out;

int numColumns = 481;



//Software Serial (RX, TX)
SoftwareSerial toRS485(11, 10);

//motorID
byte servo1 = 0x17;
byte servo2 = 0x18;

XM430 gimbal(&toRS485);

void setup() {
  // put your setup code here, to run once:
  Serial.begin(9600);
  //Start the Serial communication: One for the Nano communication, and the other for the RS485

  gimbal.BeginRS485(1000000);
  //Enable Torque, without this function the motors will not move.
  gimbal.TorqueEnable(servo1, ON);
  gimbal.TorqueEnable(servo2, ON);
}

void loop() {

  x = 0;
  y = 0;

  for (int i = 0; i < numColumns; i++) {
    //eases data to write to servo
    float targetX = Val_X[i];
    float dx = targetX - x;
    x += dx * easing;
    x_Out = round(x);


    float targetY = Val_Y[i];
    float dy = targetY - y;
    y += dy * easing;
    y_Out = round(y);

    Serial.println (y_Out);
    gimbal.Goto(servo1, x_Out);
    gimbal.Goto(servo2, y_Out);
    delay(1);
  }


  int  x_diff =  Val_X[0] - Val_X[numColumns];
  int  y_diff =  Val_Y[0] - Val_Y[numColumns];

  for (int i = 0; i < easing_time; i++)
  {
    x_Out = Val_X[numColumns] + (x_diff * (i / easing_time));
    y_Out = Val_Y[numColumns] + (y_diff * (i / easing_time));
    gimbal.Goto(servo1, x_Out);
    gimbal.Goto(servo2, y_Out);
  }

  x_Out = Val_X[0];
  y_Out = Val_Y[0];


}
